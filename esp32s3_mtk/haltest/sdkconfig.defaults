## esp32s3_mtk/wifirepro/sdkconfig.defaults
```kconfig
# The firmware's settings (../sdkconfig.defaults) without PSRAM and the custom
# partition table.
CONFIG_IDF_TARGET="esp32s3"
CONFIG_ESPTOOLPY_FLASHSIZE_4MB=y
CONFIG_ESP_DEFAULT_CPU_FREQ_MHZ_240=y
CONFIG_ESP_CONSOLE_USB_SERIAL_JTAG=y
CONFIG_MTK_BOARD_ESP32S3_MINI=y
CONFIG_FREERTOS_NUMBER_OF_CORES=2
CONFIG_MTK_SMP=y
CONFIG_MTK_SMP_CALLBACK_DETACH=y
CONFIG_FREERTOS_HZ=1000
CONFIG_ESP_TASK_WDT_INIT=n
CONFIG_ESP_TASK_WDT_CHECK_IDLE_TASK_CPU0=n
CONFIG_ESP_TASK_WDT_CHECK_IDLE_TASK_CPU1=n
CONFIG_ESP_INT_WDT_CHECK_CPU1=n
CONFIG_LWIP_ENABLE=y
CONFIG_ESP_WIFI_ENABLE_WPA3_SAE=n
CONFIG_ESP_WIFI_ENABLE_WPA3_OWE_STA=n
CONFIG_BT_ENABLED=n
CONFIG_PARTITION_TABLE_SINGLE_APP_LARGE=y
```

## legacy/esp32s3_sensor_bringup/sdkconfig.defaults
```kconfig
CONFIG_IDF_TARGET="esp32s3"
CONFIG_MTK_BOARD_ESP32S3_MINI=y
CONFIG_MTK_SMP=y
CONFIG_MTK_SMP_CALLBACK_DETACH=y
# CONFIG_FREERTOS_UNICORE is not set
# CONFIG_ESP_SYSTEM_SINGLE_CORE_MODE is not set
CONFIG_FREERTOS_NUMBER_OF_CORES=2
CONFIG_FREERTOS_HZ=1000
CONFIG_ESP_DEFAULT_CPU_FREQ_MHZ_240=y
CONFIG_ESPTOOLPY_FLASHSIZE_4MB=y
CONFIG_ESP_CONSOLE_USB_SERIAL_JTAG=y
# CONFIG_ESP_CONSOLE_UART_DEFAULT is not set
# CONFIG_BT_ENABLED is not set
# CONFIG_ESP_TASK_WDT_INIT is not set
# CONFIG_ESP_TASK_WDT_CHECK_IDLE_TASK_CPU0 is not set
# CONFIG_ESP_TASK_WDT_CHECK_IDLE_TASK_CPU1 is not set
# CONFIG_ESP_INT_WDT_CHECK_CPU1 is not set
CONFIG_COMPILER_OPTIMIZATION_ASSERTIONS_ENABLE=y
```
